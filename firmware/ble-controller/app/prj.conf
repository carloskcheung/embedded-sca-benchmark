## CMakeLists.txt
```
cmake_minimum_required(VERSION 3.20.0)

find_package(Zephyr REQUIRED HINTS $ENV{ZEPHYR_BASE})
project(acme_ble_controller VERSION 2.1.0)

set(NANOPB_DIR ${CMAKE_CURRENT_SOURCE_DIR}/../lib/nanopb)

target_sources(app PRIVATE
    src/main.c
    src/ble.c
    src/motor.c
    src/storage.c
    src/generated/motor.pb.c
    ${NANOPB_DIR}/pb_common.c
    ${NANOPB_DIR}/pb_encode.c
    ${NANOPB_DIR}/pb_decode.c
)
target_include_directories(app PRIVATE src src/generated ${NANOPB_DIR})
target_compile_definitions(app PRIVATE ACME_FW_VERSION="${PROJECT_VERSION}")
```

## prj.conf
```kconfig
# Logging over RTT (SEGGER module) and UART
CONFIG_LOG=y
CONFIG_USE_SEGGER_RTT=y
CONFIG_LOG_BACKEND_RTT=y

# Bluetooth LE peripheral
CONFIG_BT=y
CONFIG_BT_PERIPHERAL=y
CONFIG_BT_DEVICE_NAME="Acme BLE Ctl"
CONFIG_BT_SMP=y
CONFIG_BT_TINYCRYPT_ECC=y

# Persistent boot counter on littlefs
CONFIG_FLASH=y
CONFIG_FLASH_MAP=y
CONFIG_FILE_SYSTEM=y
CONFIG_FILE_SYSTEM_LITTLEFS=y

# Status digests via mbedTLS
CONFIG_MBEDTLS=y
CONFIG_MBEDTLS_BUILTIN=y
CONFIG_MBEDTLS_SHA256=y

CONFIG_MAIN_STACK_SIZE=4096
```

## src/main.c
```c
/*
 * Copyright (c) 2026 Acme Industrial Systems, Inc. All rights reserved.
 * SPDX-License-Identifier: LicenseRef-Acme-Proprietary
 *
 * Acme BLE motor controller: exposes a GATT service the gateway uses to
 * command a motor and stream its status.
 */
#include <zephyr/kernel.h>
#include <zephyr/logging/log.h>

#include "ble.h"
#include "motor.h"
#include "storage.h"

LOG_MODULE_REGISTER(main, LOG_LEVEL_INF);

int main(void)
{
    LOG_INF("acme ble-controller %s", ACME_FW_VERSION);

    storage_init();
    motor_init();
    if (ble_init() != 0) {
        return 0;
    }

    for (;;) {
        k_sleep(K_SECONDS(1));
        ble_notify_status();
    }
    return 0;
}
```

## src/ble.c
```c
/*
 * Copyright (c) 2026 Acme Industrial Systems, Inc. All rights reserved.
 * SPDX-License-Identifier: LicenseRef-Acme-Proprietary
 *
 * Acme Motor GATT service. Commands and status are nanopb-encoded protobufs
 * (see proto/motor.proto); each status frame is logged with a SHA-256 digest
 * so the gateway can correlate frames across links.
 */
#include <zephyr/bluetooth/bluetooth.h>
#include <zephyr/bluetooth/conn.h>
#include <zephyr/bluetooth/gatt.h>
#include <zephyr/bluetooth/uuid.h>
#include <zephyr/logging/log.h>

#include <mbedtls/sha256.h>
#include <pb_decode.h>
#include <pb_encode.h>

#include "ble.h"
#include "motor.h"

LOG_MODULE_REGISTER(ble, LOG_LEVEL_INF);

#define ACME_MOTOR_SVC_UUID \
    BT_UUID_128_ENCODE(0x6d6f746f, 0x7200, 0x4163, 0x6d65, 0x000000000001ULL)
#define ACME_MOTOR_CMD_UUID \
    BT_UUID_128_ENCODE(0x6d6f746f, 0x7200, 0x4163, 0x6d65, 0x000000000002ULL)
#define ACME_MOTOR_STATUS_UUID \
    BT_UUID_128_ENCODE(0x6d6f746f, 0x7200, 0x4163, 0x6d65, 0x000000000003ULL)

static struct bt_uuid_128 svc_uuid = BT_UUID_INIT_128(ACME_MOTOR_SVC_UUID);
static struct bt_uuid_128 cmd_uuid = BT_UUID_INIT_128(ACME_MOTOR_CMD_UUID);
static struct bt_uuid_128 status_uuid = BT_UUID_INIT_128(ACME_MOTOR_STATUS_UUID);

static const struct bt_data ad[] = {
    BT_DATA_BYTES(BT_DATA_FLAGS, (BT_LE_AD_GENERAL | BT_LE_AD_NO_BREDR)),
    BT_DATA_BYTES(BT_DATA_UUID128_ALL, ACME_MOTOR_SVC_UUID),
};

static const struct bt_data sd[] = {
    BT_DATA(BT_DATA_NAME_COMPLETE, CONFIG_BT_DEVICE_NAME, sizeof(CONFIG_BT_DEVICE_NAME) - 1),
};

static size_t encode_status(uint8_t *buf, size_t cap)
{
    acme_motor_MotorStatus status = acme_motor_MotorStatus_init_zero;
    pb_ostream_t stream = pb_ostream_from_buffer(buf, cap);

    motor_get_status(&status);
    if (!pb_encode(&stream, acme_motor_MotorStatus_fields, &status)) {
        LOG_ERR("status encode failed: %s", PB_GET_ERROR(&stream));
        return 0;
    }
    return stream.bytes_written;
}

static ssize_t write_cmd(struct bt_conn *conn, const struct bt_gatt_attr *attr,
                         const void *buf, uint16_t len, uint16_t offset, uint8_t flags)
{
    acme_motor_MotorCommand cmd = acme_motor_MotorCommand_init_zero;
    pb_istream_t stream = pb_istream_from_buffer(buf, len);

    if (offset != 0) {
        return BT_GATT_ERR(BT_ATT_ERR_INVALID_OFFSET);
    }
    if (!pb_decode(&stream, acme_motor_MotorCommand_fields, &cmd)) {
        LOG_WRN("bad command: %s", PB_GET_ERROR(&stream));
        return BT_GATT_ERR(BT_ATT_ERR_VALUE_NOT_ALLOWED);
    }
    motor_apply(&cmd);
    return len;
}

static ssize_t read_status(struct bt_conn *conn, const struct bt_gatt_attr *attr,
                           void *buf, uint16_t len, uint16_t offset)
{
    uint8_t frame[acme_motor_MotorStatus_size];
    size_t n = encode_status(frame, sizeof(frame));

    return bt_gatt_attr_read(conn, attr, buf, len, offset, frame, n);
}

static void status_ccc_changed(const struct bt_gatt_attr *attr, uint16_t value)
{
    LOG_INF("status notifications %s", value == BT_GATT_CCC_NOTIFY ? "on" : "off");
}

BT_GATT_SERVICE_DEFINE(acme_motor_svc,
    BT_GATT_PRIMARY_SERVICE(&svc_uuid),
    BT_GATT_CHARACTERISTIC(&cmd_uuid.uuid, BT_GATT_CHRC_WRITE,
                           BT_GATT_PERM_WRITE_ENCRYPT, NULL, write_cmd, NULL),
    BT_GATT_CHARACTERISTIC(&status_uuid.uuid, BT_GATT_CHRC_READ | BT_GATT_CHRC_NOTIFY,
                           BT_GATT_PERM_READ, read_status, NULL, NULL),
    BT_GATT_CCC(status_ccc_changed, BT_GATT_PERM_READ | BT_GATT_PERM_WRITE),
);

void ble_notify_status(void)
{
    uint8_t frame[acme_motor_MotorStatus_size];
    uint8_t digest[32];
    size_t n = encode_status(frame, sizeof(frame));

    if (n == 0) {
        return;
    }
    mbedtls_sha256(frame, n, digest, 0);
    LOG_DBG("status frame %zu bytes, sha256 %02x%02x%02x%02x...", n,
            digest[0], digest[1], digest[2], digest[3]);
    bt_gatt_notify(NULL, &acme_motor_svc.attrs[3], frame, n);
}

int ble_init(void)
{
    int err = bt_enable(NULL);

    if (err) {
        LOG_ERR("bt_enable failed: %d", err);
        return err;
    }
    err = bt_le_adv_start(BT_LE_ADV_CONN, ad, ARRAY_SIZE(ad), sd, ARRAY_SIZE(sd));
    if (err) {
        LOG_ERR("advertising failed: %d", err);
        return err;
    }
    LOG_INF("advertising as \"%s\"", CONFIG_BT_DEVICE_NAME);
    return 0;
}
```

## src/ble.h
```c
/*
 * Copyright (c) 2026 Acme Industrial Systems, Inc. All rights reserved.
 * SPDX-License-Identifier: LicenseRef-Acme-Proprietary
 */
#ifndef ACME_BLE_H
#define ACME_BLE_H

int ble_init(void);

/* Push the current motor status to subscribed centrals. */
void ble_notify_status(void);

#endif
```

## src/motor.c
```c
/*
 * Copyright (c) 2026 Acme Industrial Systems, Inc. All rights reserved.
 * SPDX-License-Identifier: LicenseRef-Acme-Proprietary
 *
 * Simulated BLDC motor: ramps toward the commanded RPM every 100 ms. The
 * production board drives a TMC6300 through PWM; that driver is not part of
 * this demo.
 */
#include <zephyr/kernel.h>
#include <zephyr/logging/log.h>

#include "motor.h"
#include "storage.h"

LOG_MODULE_REGISTER(motor, LOG_LEVEL_INF);

#define RAMP_STEP_RPM 50
#define MAX_RPM       6000

static struct {
    bool enabled;
    uint32_t target_rpm;
    uint32_t rpm;
} motor;

static void ramp_handler(struct k_work *work);
static K_WORK_DELAYABLE_DEFINE(ramp_work, ramp_handler);

static void ramp_handler(struct k_work *work)
{
    uint32_t target = motor.enabled ? motor.target_rpm : 0;

    if (motor.rpm < target) {
        motor.rpm = MIN(motor.rpm + RAMP_STEP_RPM, target);
    } else if (motor.rpm > target) {
        motor.rpm = motor.rpm > target + RAMP_STEP_RPM ? motor.rpm - RAMP_STEP_RPM : target;
    }
    k_work_reschedule(k_work_delayable_from_work(work), K_MSEC(100));
}

void motor_init(void)
{
    k_work_reschedule(&ramp_work, K_MSEC(100));
}

void motor_apply(const acme_motor_MotorCommand *cmd)
{
    motor.enabled = cmd->enable;
    motor.target_rpm = MIN(cmd->target_rpm, MAX_RPM);
    LOG_INF("command: enable=%d target=%u rpm", motor.enabled, motor.target_rpm);
}

void motor_get_status(acme_motor_MotorStatus *status)
{
    status->state = motor.rpm > 0 ? acme_motor_MotorState_MOTOR_RUNNING
                                  : acme_motor_MotorState_MOTOR_IDLE;
    status->rpm = motor.rpm;
    status->boot_count = storage_boot_count();
    status->uptime_s = (uint32_t)(k_uptime_get() / 1000);
}
```

## src/motor.h
```c
/*
 * Copyright (c) 2026 Acme Industrial Systems, Inc. All rights reserved.
 * SPDX-License-Identifier: LicenseRef-Acme-Proprietary
 */
#ifndef ACME_MOTOR_H
#define ACME_MOTOR_H

#include "motor.pb.h"

void motor_init(void);
void motor_apply(const acme_motor_MotorCommand *cmd);
void motor_get_status(acme_motor_MotorStatus *status);

#endif
```

## src/storage.c
```c
/*
 * Copyright (c) 2026 Acme Industrial Systems, Inc. All rights reserved.
 * SPDX-License-Identifier: LicenseRef-Acme-Proprietary
 */
#include <zephyr/fs/fs.h>
#include <zephyr/fs/littlefs.h>
#include <zephyr/logging/log.h>
#include <zephyr/storage/flash_map.h>

#include "storage.h"

LOG_MODULE_REGISTER(storage, LOG_LEVEL_INF);

#define BOOT_COUNT_PATH "/lfs/boot_count"

FS_LITTLEFS_DECLARE_DEFAULT_CONFIG(lfs_data);

static struct fs_mount_t lfs_mnt = {
    .type = FS_LITTLEFS,
    .fs_data = &lfs_data,
    .storage_dev = (void *)FIXED_PARTITION_ID(storage_partition),
    .mnt_point = "/lfs",
};

static uint32_t boot_count;

int storage_init(void)
{
    struct fs_file_t file;
    int rc;

    rc = fs_mount(&lfs_mnt);
    if (rc < 0) {
        LOG_ERR("littlefs mount failed: %d", rc);
        return rc;
    }

    fs_file_t_init(&file);
    rc = fs_open(&file, BOOT_COUNT_PATH, FS_O_CREATE | FS_O_RDWR);
    if (rc < 0) {
        return rc;
    }
    if (fs_read(&file, &boot_count, sizeof(boot_count)) != sizeof(boot_count)) {
        boot_count = 0;
    }
    boot_count++;
    fs_seek(&file, 0, FS_SEEK_SET);
    fs_write(&file, &boot_count, sizeof(boot_count));
    fs_close(&file);

    LOG_INF("boot #%u", boot_count);
    return 0;
}

uint32_t storage_boot_count(void)
{
    return boot_count;
}
```

## src/storage.h
```c
/*
 * Copyright (c) 2026 Acme Industrial Systems, Inc. All rights reserved.
 * SPDX-License-Identifier: LicenseRef-Acme-Proprietary
 */
#ifndef ACME_STORAGE_H
#define ACME_STORAGE_H

#include <stdint.h>

/* Mount littlefs and increment the persistent boot counter. */
int storage_init(void);
uint32_t storage_boot_count(void);

#endif
```
