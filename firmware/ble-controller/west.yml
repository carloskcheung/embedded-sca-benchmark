## yocto/meta-acme/conf/layer.conf
```bitbake
BBPATH .= ":${LAYERDIR}"

BBFILES += "${LAYERDIR}/recipes-*/*/*.bb \
            ${LAYERDIR}/recipes-*/*/*.bbappend"

BBFILE_COLLECTIONS += "acme"
BBFILE_PATTERN_acme = "^${LAYERDIR}/"
BBFILE_PRIORITY_acme = "10"

LAYERVERSION_acme = "1"
LAYERDEPENDS_acme = "core openembedded-layer networking-layer"
LAYERSERIES_COMPAT_acme = "scarthgap"
```
